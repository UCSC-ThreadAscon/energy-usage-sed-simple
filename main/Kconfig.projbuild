## main/Kconfig.projbuild
```kconfig
#
# I use the following resource to learn how to create KConfig
# configurations:
# https://medium.com/@bhautik.markeye/esp-idf-configuration-how-to-add-custom-configuration-in-project-config-728f81b8d0d8.
#

menu "OpenThread Deep Sleep Sender"

  config TX_POWER
    int 'Set the 802.15.4 TX power used by OpenThread'
    range -128 127
    default 20
    help
        Set the 802.15.4 transmission power (in dBm) for OpenThread.
        The recommended TX power values are 20 dBm, 9 dBm, 0 dBm, and -25 dBm.

    config COAP_SERVER_PORT
      int 'The port number for the CoAP server.'
      default 5683
      help
          Sets the port used by CoAP server side.

    config COAP_SOCK_PORT
      int 'The port number for the CoAP socket.'
      default 5683
      help
          Sets the port used by the CoAP socket for this device.

    config SERVER_IP_ADDRESS
      string 'The IP address of the server to send CoAP packets to.'
      help
          Sets the IPv6 address of the server to send CoAP packets to.

    config SCENARIO
      int 'The specific role that the device will play during the experiment.'
      default 1
      range 1 4
      help
          Enter "1" if the device simulates the motion sensor at the front door.
          Enter "2" if the device simulates the air quality monitor.
          Enter "3" if the device simulates the window sensor.
          Enter "4" for the device to send an event packet every wakeup (used for debugging purposes).
endmenu
```
